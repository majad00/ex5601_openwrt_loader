## source/ubi_patch/.matrix_ex5601_build/parts/openwrt-labelswap.its
```
/dts-v1/;

/ {
	description = "ARM64 OpenWrt FIT labelswap";
	#address-cells = <1>;

	images {
		kernel-1 {
			description = "ARM64 OpenWrt Linux";
			data = /incbin/("kernel.lzma");
			type = "kernel";
			arch = "arm64";
			os = "linux";
			compression = "lzma";
			load = <0x48000000>;
			entry = <0x48000000>;

			hash-1 {
				algo = "crc32";
			};

			hash-2 {
				algo = "sha1";
			};
		};

		fdt-1 {
			description = "EX5601-T0 labelswap DTB";
			data = /incbin/("patched-labelswap.dtb");
			type = "flat_dt";
			arch = "arm64";
			compression = "none";

			hash-1 {
				algo = "crc32";
			};

			hash-2 {
				algo = "sha1";
			};
		};
	};

	configurations {
		default = "config-1";

		config-1 {
			description = "OpenWrt labelswap";
			kernel = "kernel-1";
			fdt = "fdt-1";
		};
	};
};
```
